// SPDX-License-Identifier: GPL-2.0+
/*
 * Custom RK3326 R36S Clone Board
 */
 /dts-v1/;

 #include "rk3326-evb-lp3-v10-linux.dts"
 
/ {
	compatible = "rockchip,rk3326-evb-lp3-v12-linux", "rockchip,rk3326";
	interrupt-parent = <0x01>;
	#address-cells = <0x02>;
	#size-cells = <0x02>;
	model = "Rockchip rk3326 evb lpddr3 v12 board for linux";
};